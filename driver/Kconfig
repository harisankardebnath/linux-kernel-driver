## driver/Kconfig
```kconfig
config REVERSE_EXE
    tristate "reverse_exe diagnostic module"
    depends on ARM64
    help
      Builds the reverse_exe diagnostic character device exposing a bounded
      private test buffer. It does not access other processes or physical memory.
```
